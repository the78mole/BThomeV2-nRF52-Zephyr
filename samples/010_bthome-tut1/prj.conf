## CMakeLists.txt
```
# SPDX-License-Identifier: MIT
cmake_minimum_required(VERSION 3.20)
find_package(Zephyr REQUIRED HINTS $ENV{ZEPHYR_BASE})
project(bthome_full_node)
target_sources(app PRIVATE
    src/main.c
    src/sensors/sensor_die_temp.c
    src/sensors/sensor_imu.c
    src/sensors/sensor_pir.c
)
target_include_directories(app PRIVATE src)
```

## prj.conf
```kconfig
# ── Bluetooth ──────────────────────────────────────────────────────────────
CONFIG_BT=y
CONFIG_BT_PERIPHERAL=y
CONFIG_BT_DEVICE_NAME="MAKE-010"

# ── BThome V2 library ───────────────────────────────────────────────────────
CONFIG_BTHOME_V2=y

# ── Sensor framework ────────────────────────────────────────────────────────
CONFIG_SENSOR=y
CONFIG_I2C=y

# ── nRF52 internal die-temperature sensor ───────────────────────────────────
CONFIG_TEMP_NRF5=y

# ── IMU: select ONE depending on hardware (see board-specific .conf files) ──
# CONFIG_MPU6050=y     # nRF52840-DK + MPU-6050 breakout
# CONFIG_LSM6DSL=y     # Seeed XIAO nRF52840 Sense (LSM6DS3 = LSM6DSL-compatible)

# ── GPIO ────────────────────────────────────────────────────────────────────
CONFIG_GPIO=y

# ── Logging ─────────────────────────────────────────────────────────────────
CONFIG_LOG=y
CONFIG_LOG_DEFAULT_LEVEL=3

# ── Stack sizes ─────────────────────────────────────────────────────────────
CONFIG_MAIN_STACK_SIZE=2048
CONFIG_BT_RX_STACK_SIZE=1024
```

## boards/xiao_ble.conf
```kconfig
# Seeed XIAO nRF52840 (plain) — board-specific config for bthome_full_node
#
# The XIAO nRF52840 has NO external 32.768 kHz crystal.
# Use the internal RC oscillator (LFRC) for BLE — mandatory!
# With RC source the default accuracy is already 500 PPM (no extra config needed).
CONFIG_CLOCK_CONTROL_NRF_K32SRC_RC=y

# Plain XIAO has no IMU — use xiao_ble_sense for the Sense variant.
```

## boards/xiao_ble_sense.conf
```kconfig
# Seeed XIAO nRF52840 Sense — board-specific config for bthome_full_node
#
# The XIAO nRF52840 has NO external 32.768 kHz crystal.
# Use the internal RC oscillator (LFRC) for BLE — mandatory!
# With RC source the default accuracy is already 500 PPM (no extra config needed).
CONFIG_CLOCK_CONTROL_NRF_K32SRC_RC=y

# IMU: LSM6DS3TR-C on the Sense variant (LSM6DSL-compatible driver)
CONFIG_LSM6DSL=y
```

## boards/xiao_ble.overlay
```dts
/* SPDX-License-Identifier: MIT */
/*
 * bthome_full_node overlay for Seeed XIAO nRF52840 (plain, no IMU)
 *
 * The plain xiao_ble has no LSM6DS3 — disable IMU and PIR alias only.
 * Use BOARD=xiao_ble_sense for the Sense variant with IMU.
 */

/* ── PIR sensor GPIO ────────────────────────────────────────────────────── */
/ {
	pir_inputs: pir_inputs {
		compatible = "gpio-keys";
		pir0: pir_0 {
			gpios = <&gpio0 29 (GPIO_ACTIVE_HIGH | GPIO_PULL_DOWN)>;
			label = "PIR Sensor";
		};
	};

	aliases {
		pir-sensor = &pir0;
	};
};
```

## boards/xiao_ble_sense.overlay
```dts
/* SPDX-License-Identifier: MIT */
/*
 * bthome_full_node overlay for Seeed XIAO nRF52840 Sense
 *
 * The LSM6DS3TR-C on i2c0 is already defined in the board DTS
 * (xiao_ble_sense.dts) — we only add the imu alias and the PIR GPIO.
 *
 *   IMU  : lsm6ds3tr_c @ 0x6A on i2c0 (P0.07=SDA, P0.27=SCL)
 *          Power-enable: P1.08 (handled by board DTS regulator node)
 *   PIR  : P0.29 (XIAO D3), active-high with pull-down
 */

/* ── PIR sensor GPIO ────────────────────────────────────────────────────── */
/ {
	pir_inputs: pir_inputs {
		compatible = "gpio-keys";
		pir0: pir_0 {
			gpios = <&gpio0 29 (GPIO_ACTIVE_HIGH | GPIO_PULL_DOWN)>;
			label = "PIR Sensor";
		};
	};

	aliases {
		imu        = &lsm6ds3tr_c;
		pir-sensor = &pir0;
	};
};
```

## src/main.c
```c
/* SPDX-License-Identifier: MIT */
/*
 * Copyright (c) 2026 Daniel Glaser
 *
 * BThome V2 Full-Node Sample
 * ==========================
 * Combines three sensor sources into one BThome V2 BLE advertisement:
 *
 *  1. Die temperature   — nRF52840 internal temperature sensor (always present)
 *  2. 6-axis IMU        — MPU-6050 (nRF52840-DK) or LSM6DS3/LSM6DSL (XIAO Sense)
 *                         Advertises acceleration and gyroscope magnitude.
 *  3. PIR motion sensor — GPIO binary sensor (active-high, DT alias "pir-sensor")
 *
 * The device advertises a new BThome V2 packet every ADVERT_INTERVAL_SEC seconds.
 *
 * Build (nRF52840-DK with MPU-6050 breakout):
 *   west build -b nrf52840dk/nrf52840 samples/bthome_full_node
 *
 * Build (Seeed XIAO nRF52840 Sense):
 *   west build -b seeed_xiao_ble/nrf52840 samples/bthome_full_node
 *
 * Verify with bthome-logger:
 *   uv tool install bthome-logger && bthome-logger -f "MAKE"
 */

#include <zephyr/kernel.h>
#include <zephyr/logging/log.h>
#include <zephyr/bluetooth/bluetooth.h>
#include <zephyr/bluetooth/hci.h>
#include <zephyr/drivers/gpio.h>

#include <bthome_v2/bthome_v2.h>

#include "sensors/sensor_die_temp.h"
#include "sensors/sensor_imu.h"
#include "sensors/sensor_pir.h"

LOG_MODULE_REGISTER(bthome_node, LOG_LEVEL_INF);

/* ── Timing ──────────────────────────────────────────────────────────────── */
#define ADVERT_INTERVAL_SEC  10

/* ── BLE advertising parameters ─────────────────────────────────────────── */
static const struct bt_le_adv_param adv_param =
	BT_LE_ADV_PARAM_INIT(BT_LE_ADV_OPT_USE_IDENTITY,
			     BT_GAP_ADV_SLOW_INT_MIN,
			     BT_GAP_ADV_SLOW_INT_MAX,
			     NULL);

/* ── BThome V2 context ───────────────────────────────────────────────────── */
static struct bthome_v2_ctx bthome;

/* ── Advertising data: Flags + Name + BThome service data ──────────────── */
/* Layout: flags(3B) + name(10B) + svcdata(18B) = 31B exactly — no overflow */
static struct bt_data ad[3];

/* ── Packet counter (incremented each advertisement) ────────────────────── */
static uint8_t pkt_id;

/* ── LED2 (alias "led1" on nRF52840-DK) ─────────────────────────────────── */
#if DT_NODE_HAS_STATUS(DT_ALIAS(led1), okay)
static const struct gpio_dt_spec led2 =
	GPIO_DT_SPEC_GET(DT_ALIAS(led1), gpios);
#define HAS_LED2 1
#else
#define HAS_LED2 0
#endif

/* ── Sensor read & advertise ─────────────────────────────────────────────── */

static void update_advertisement(void)
{
	int ret;

#if HAS_LED2
	gpio_pin_set_dt(&led2, 1);
#endif

	bthome_v2_clear(&bthome);
	bthome_v2_add_packet_id(&bthome, pkt_id++);

	sensor_die_temp_update(&bthome);
	sensor_imu_update(&bthome);
	sensor_pir_update(&bthome);

	/* ── Encode & update advertising ─────────────────────────────────── */
	ret = bthome_v2_encode(&bthome);
	if (ret < 0) {
		LOG_ERR("BThome encode failed: %d", ret);
		return;
	}

	ret = bthome_v2_get_bt_data(&bthome, &ad[2]);
	if (ret < 0) {
		LOG_ERR("bthome_v2_get_bt_data failed: %d", ret);
		return;
	}

	ret = bt_le_adv_update_data(ad, ARRAY_SIZE(ad), NULL, 0);
	if (ret < 0) {
		LOG_ERR("BLE adv update failed: %d", ret);
	}

#if HAS_LED2
	k_sleep(K_MSEC(50));
	gpio_pin_set_dt(&led2, 0);
#endif
}

/* ── Main ────────────────────────────────────────────────────────────────── */

int main(void)
{
	int ret;

	LOG_INF("BThome V2 Full-Node starting");

	/* ── Initialise LED2 ────────────────────────────────────────────── */
#if HAS_LED2
	if (gpio_is_ready_dt(&led2)) {
		gpio_pin_configure_dt(&led2, GPIO_OUTPUT_INACTIVE);
	}
#endif

	/* ── Initialise sensors ─────────────────────────────────────────── */
	sensor_pir_init();

	/* ── Initialise BThome V2 context ───────────────────────────────── */
	bthome_v2_init(&bthome, false, false);

	/* ── Build initial advertising data ────────────────────────────── */
	ad[0] = (struct bt_data)
		BT_DATA_BYTES(BT_DATA_FLAGS,
			      BT_LE_AD_GENERAL | BT_LE_AD_NO_BREDR);
	ad[1] = (struct bt_data)
		BT_DATA(BT_DATA_NAME_COMPLETE,
			CONFIG_BT_DEVICE_NAME,
			sizeof(CONFIG_BT_DEVICE_NAME) - 1);

	bthome_v2_add_packet_id(&bthome, 0);
	bthome_v2_encode(&bthome);
	bthome_v2_get_bt_data(&bthome, &ad[2]);
	bthome_v2_clear(&bthome);

	/* ── Enable Bluetooth ───────────────────────────────────────────── */
	ret = bt_enable(NULL);
	if (ret) {
		LOG_ERR("bt_enable failed: %d", ret);
		return ret;
	}
	LOG_INF("Bluetooth enabled");

	/* ── Start advertising ──────────────────────────────────────────── */
	ret = bt_le_adv_start(&adv_param, ad, ARRAY_SIZE(ad), NULL, 0);
	if (ret) {
		LOG_ERR("bt_le_adv_start failed: %d", ret);
		return ret;
	}
	LOG_INF("Advertising started (interval ~%d ms)",
		BT_GAP_ADV_SLOW_INT_MIN * 625 / 1000);

	/* ── Main loop ──────────────────────────────────────────────────── */
	while (true) {
		update_advertisement();
		k_sleep(K_SECONDS(ADVERT_INTERVAL_SEC));
	}

	return 0;
}
```
