## CMakeLists.txt
```
# SPDX-License-Identifier: MIT
cmake_minimum_required(VERSION 3.20)
find_package(Zephyr REQUIRED HINTS $ENV{ZEPHYR_BASE})
project(blinky)
target_sources(app PRIVATE src/main.c)
```

## prj.conf
```kconfig
# Blinky sample – no extra config needed; LED alias is defined on all target boards.
CONFIG_GPIO=y
```

## boards/nrf52840dk_nrf52840.overlay
```dts
/* SPDX-License-Identifier: MIT */
/*
 * Blinky overlay for nRF52840-DK
 *
 * No modifications needed — the DK board file already defines the
 * led0 alias pointing to LED1 (P0.13, active-low).
 * This overlay is intentionally empty but kept for completeness and
 * to document the hardware assignment.
 *
 * Hardware:
 *   LED0 → P0.13 (green, active-low, on-board)
 */
```

## src/main.c
```c
/* SPDX-License-Identifier: MIT */
/*
 * Copyright (c) 2026 Daniel Glaser
 *
 * Blinky sample for nRF52840-DK and Seeed XIAO nRF52840 (Sense & Plus)
 *
 * LED timing: 100 ms ON / 900 ms OFF
 *
 * Build:
 *   west build -b nrf52840dk/nrf52840    samples/blinky
 *   west build -b seeed_xiao_ble/nrf52840 samples/blinky
 */

#include <zephyr/kernel.h>
#include <zephyr/drivers/gpio.h>

/* Use the board-agnostic "led0" alias defined in every target's DTS. */
static const struct gpio_dt_spec led =
	GPIO_DT_SPEC_GET(DT_ALIAS(led0), gpios);

int main(void)
{
	int ret;

	if (!gpio_is_ready_dt(&led)) {
		return -ENODEV;
	}

	ret = gpio_pin_configure_dt(&led, GPIO_OUTPUT_INACTIVE);
	if (ret < 0) {
		return ret;
	}

	while (true) {
		/* 100 ms ON */
		gpio_pin_set_dt(&led, 1);
		k_sleep(K_MSEC(100));

		/* 900 ms OFF */
		gpio_pin_set_dt(&led, 0);
		k_sleep(K_MSEC(900));
	}

	return 0;
}
```
