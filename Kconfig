## lib/bthome_v2/Kconfig
```kconfig
# SPDX-License-Identifier: MIT
# lib/bthome_v2/Kconfig

config BTHOME_V2
	bool "BThome V2 BLE advertising library"
	depends on BT
	help
	  Enable the BThome V2 library for encoding sensor data into the
	  BThome V2 format (UUID 0xFCD2) and advertising it over BLE.

	  The library provides a statically-allocated encoder context,
	  helper functions for all standard BThome V2 object types, and a
	  Zephyr bt_data helper for direct use with bt_le_adv_start().

	  Specification: https://bthome.io/format/
```

## west.yml
```yaml
manifest:
  remotes:
    - name: nrfconnect
      url-base: https://github.com/nrfconnect

  projects:
    - name: nrf
      remote: nrfconnect
      repo-path: sdk-nrf
      revision: v2.6.0
      import: true

  self:
    path: bthomev2-nrf52-zephyr
```
